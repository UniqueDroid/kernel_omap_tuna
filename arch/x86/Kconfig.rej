## arch/x86/Kconfig.rej
```kconfig
--- arch/x86/Kconfig	2012-03-24 19:30:00.013420381 +1100
+++ arch/x86/Kconfig	2012-03-24 19:30:29.044925845 +1100
@@ -806,15 +806,7 @@
 	  increased overhead in some places. If unsure say N here.
 
 config IRQ_TIME_ACCOUNTING
-	bool "Fine granularity task level IRQ time accounting"
-	default n
-	---help---
-	  Select this option to enable fine granularity task irq time
-	  accounting. This is done by reading a timestamp on each
-	  transitions between softirq and hardirq state, so there can be a
-	  small performance impact.
-
-	  If in doubt, say N here.
+	def_bool y
 
 source "kernel/Kconfig.preempt"
 
```

## init/Kconfig.rej
```kconfig
--- init/Kconfig	2012-03-24 19:30:29.040925775 +1100
+++ init/Kconfig	2012-03-24 19:30:00.013420381 +1100
@@ -727,7 +713,6 @@
 
 menuconfig CGROUP_SCHED
 	bool "Group CPU scheduler"
-	depends on !SCHED_BFS
 	default n
 	help
 	  This feature lets CPU scheduler recognize task groups and control CPU
```

## lib/Kconfig.debug.rej
```kconfig
--- lib/Kconfig.debug	2012-03-24 19:30:00.012420362 +1100
+++ lib/Kconfig.debug	2012-03-24 19:30:29.042925809 +1100
@@ -875,7 +875,7 @@
 
 config RCU_TORTURE_TEST
 	tristate "torture tests for RCU"
-	depends on DEBUG_KERNEL
+	depends on DEBUG_KERNEL && !SCHED_BFS
 	default n
 	help
 	  This option provides a kernel module that runs torture tests
```
